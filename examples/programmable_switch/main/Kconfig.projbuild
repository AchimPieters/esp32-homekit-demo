## examples/programmable_switch/main/Kconfig.projbuild
```kconfig
menu "StudioPieters"

      config ESP_WIFI_SSID
              string "WiFi SSID"
              default "myssid"
              help
                  SSID (network name) for the example to connect to.

      config ESP_WIFI_PASSWORD
              string "WiFi Password"
              default "mypassword"
              help
                  WiFi password (WPA or WPA2) for the example to use.

      config ESP_LED_GPIO
              int "Set the GPIO for the LED"
              default 2
              help
                  The GPIO number the LED is connected to.

      config ESP_BUTTON_GPIO
              int "Set the GPIO for the Button"
              default 4 if IDF_TARGET_ESP8266 || IDF_TARGET_ESP32C3 || IDF_TARGET_ESP32C2 || IDF_TARGET_ESP32C6
              default 17 if IDF_TARGET_ESP32 || IDF_TARGET_ESP32S2 || IDF_TARGET_ESP32S3
              help
                  This the default GPIO of the Program button of an ESP board.

      config ESP_SETUP_CODE
              string "HomeKit Setup Code"
              default "323-33-757"
              help
                  If you want to change the HomeKit Setup Code, you can do that here (Note:  you need to make a new QR-CODE To make it work)

      config ESP_SETUP_ID
              string "HomeKit Setup ID"
              default "7P7S"
              help
                   If you want to change the HomeKit Setup ID, you can do that here (Note: you need to make a new QR-CODE To make it work)

endmenu
```

## examples/thermostat/main/Kconfig.projbuild
```kconfig
menu "StudioPieters"

      config ESP_WIFI_SSID
              string "WiFi SSID"
              default "myssid"
              help
                  SSID (network name) for the example to connect to.

      config ESP_WIFI_PASSWORD
              string "WiFi Password"
              default "mypassword"
              help
                  WiFi password (WPA or WPA2) for the example to use.

      config ESP_LED_GPIO
              int "Set the GPIO for the LED"
              default 2
              help
                  The GPIO number the LED is connected to.

      choice EXAMPLE_CHIP_TYPE
              prompt "Select chip type"
              default EXAMPLE_TYPE_AM2301

              config EXAMPLE_TYPE_DHT11
                    bool "DHT11"
              config EXAMPLE_TYPE_AM2301
                    bool "DHT21/DHT22/AM2301/AM2302/AM2321"
              config EXAMPLE_TYPE_SI7021
                    bool "Itead Si7021"
      endchoice

      config ESP_TEMP_SENSOR_GPIO
                int "Data GPIO number"
                    default 4 if IDF_TARGET_ESP8266 || IDF_TARGET_ESP32C3
                    default 17 if IDF_TARGET_ESP32 || IDF_TARGET_ESP32S2 || IDF_TARGET_ESP32S3
                help
                    GPIO number connected to DATA pin

      config EXAMPLE_INTERNAL_PULLUP
                bool "Enable internal pull-up resistor"
                  default 0
                    help
                      Check this option if you don't have external pull-up resistor on data GPIO.
                      DHT sensors that come mounted on a PCB generally have pull-up resistors on the data pin.
                      But for stable operation, it is recommended to provide an external pull-up resistor.

      config ESP_FAN_GPIO
              int "Set the GPIO for the Fan"
              default 25
              help
                  The GPIO number the fan is connected to.

      config ESP_COOLER_GPIO
              int "Set the GPIO for the Cooler"
              default 26
              help
                  The GPIO number the cooler is connected to.

      config ESP_HEATER_GPIO
                int "Set the GPIO for the Heater"
                default 27
                help
                    The GPIO number the heater is connected to.

      config ESP_SETUP_CODE
              string "HomeKit Setup Code"
              default "338-77-883"
              help
                  If you want to change the HomeKit Setup Code, you can do that here (Note:  you need to make a new QR-CODE To make it work)

      config ESP_SETUP_ID
              string "HomeKit Setup ID"
              default "1QJ8"
              help
                   If you want to change the HomeKit Setup ID, you can do that here (Note: you need to make a new QR-CODE To make it work)

endmenu
```
