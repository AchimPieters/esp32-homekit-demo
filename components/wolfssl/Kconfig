## examples/light_strip/main/Kconfig.projbuild
```kconfig
menu "StudioPieters"

      config ESP_WIFI_SSID
              string "WiFi SSID"
              default "myssid"
              help
                  SSID (network name) for the example to connect to.

      config ESP_WIFI_PASSWORD
              string "WiFi Password"
              default "mypassword"
              help
                  WiFi password (WPA or WPA2) for the example to use.

      config ESP_LED_GPIO
              int "Set the GPIO for the LED"
              default 2
              help
                  The GPIO number the LED is connected to.

      choice LED_MODEL
              prompt "Select chip type"
              default LED_MODEL_WS2812

              config LED_MODEL_WS2812
                    bool "WS2812"
              config LED_MODEL_SK6812
                    bool "SK6812"
              endchoice

      config ESP_STRIP_LENGTH
              int "Set the number of LED's of your strip"
              default 3
              help
                  The number of LED's On the connected strip.

      choice LED_PIXEL_FORMAT
              prompt "Select color"
              default LED_PIXEL_FORMAT_GRB

              config LED_PIXEL_FORMAT_GRB
                    bool "GRB"
              config LED_PIXEL_FORMAT_GRBW
                    bool "GRBW"
              endchoice

      config ESP_SETUP_CODE
              string "HomeKit Setup Code"
              default "338-77-883"
              help
                  If you want to change the HomeKit Setup Code, you can do that here (Note:  you need to make a new QR-CODE To make it work)

      config ESP_SETUP_ID
              string "HomeKit Setup ID"
              default "1QJ8"
              help
                   If you want to change the HomeKit Setup ID, you can do that here (Note: you need to make a new QR-CODE To make it work)

endmenu
```

## examples/light_white_strip/main/Kconfig.projbuild
```kconfig
menu "StudioPieters"

      config ESP_WIFI_SSID
              string "WiFi SSID"
              default "myssid"
              help
                  SSID (network name) for the example to connect to.

      config ESP_WIFI_PASSWORD
              string "WiFi Password"
              default "mypassword"
              help
                  WiFi password (WPA or WPA2) for the example to use.

      config ESP_WW_LED_GPIO
              int "Set the GPIO for the Warm White LED's"
              default 25
              help
                  The GPIO number the Warm White LED's are connected to.

      config ESP_CW_LED_GPIO
              int "Set the GPIO for the Cool White LED's"
              default 26
              help
                  The GPIO number the Cool White LED's are connected to.

      config ESP_SETUP_CODE
              string "HomeKit Setup Code"
              default "338-77-883"
              help
                  If you want to change the HomeKit Setup Code, you can do that here (Note:  you need to make a new QR-CODE To make it work)

      config ESP_SETUP_ID
              string "HomeKit Setup ID"
              default "1QJ8"
              help
                   If you want to change the HomeKit Setup ID, you can do that here (Note: you need to make a new QR-CODE To make it work)

endmenu
```

## examples/light_white_strip/sdkconfig.defaults.esp32p4
```kconfig
CONFIG_PARTITION_TABLE_CUSTOM=y
CONFIG_PARTITION_TABLE_CUSTOM_FILENAME="partitions/partitions_esp32p4.csv"
CONFIG_PARTITION_TABLE_FILENAME="partitions/partitions_esp32p4.csv"

#
# ESP-Driver:LEDC Configurations
#
CONFIG_LEDC_CTRL_FUNC_IN_IRAM=y
# end of ESP-Driver:LEDC Configurations
```

## examples/lock/main/Kconfig.projbuild
```kconfig
menu "StudioPieters"

      config ESP_WIFI_SSID
              string "WiFi SSID"
              default "myssid"
              help
                  SSID (network name) for the example to connect to.

      config ESP_WIFI_PASSWORD
              string "WiFi Password"
              default "mypassword"
              help
                  WiFi password (WPA or WPA2) for the example to use.

      config ESP_LED_GPIO
              int "Set the GPIO for the LED"
              default 2
              help
                  The GPIO number the LED is connected to.

      config ESP_BUTTON_GPIO
              int "Set the GPIO for the Toggle Button"
              default 33
              help
                  This the default GPIO of the toggle button of an ESP board.

      config ESP_RELAY_GPIO
              int "Set the GPIO for the Relay"
              default 4
              help
                  The GPIO number the Relay is connected to.

      config ESP_LOCK_OPEN
              int "Set the lock open time in seconds"
              default 5
              help
                  Set the Time you want the lock to stay open in seconds.

      config ESP_SETUP_CODE
              string "HomeKit Setup Code"
              default "737-33-394"
              help
                  If you want to change the HomeKit Setup Code, you can do that here (Note:  you need to make a new QR-CODE To make it work)

      config ESP_SETUP_ID
              string "HomeKit Setup ID"
              default "L0CK"
              help
                   If you want to change the HomeKit Setup ID, you can do that here (Note: you need to make a new QR-CODE To make it work)

endmenu
```

## examples/lsc_smart_plug/main/Kconfig.projbuild
```kconfig
menu "StudioPieters"

      config ESP_WIFI_SSID
              string "WiFi SSID"
              default "myssid"
              help
                  SSID (network name) for the example to connect to.

      config ESP_WIFI_PASSWORD
              string "WiFi Password"
              default "mypassword"
              help
                  WiFi password (WPA or WPA2) for the example to use.

      config ESP_LED_GPIO
              int "Set the GPIO for the LED"
              default 2
              help
                  The GPIO number the LED is connected to.

      config ESP_BUTTON_GPIO
              int "Set the GPIO for the Toggle Button"
              default 10
              help
                  This the default GPIO of the toggle button of an ESP board.

      config ESP_RELAY_GPIO
              int "Set the GPIO for the Relay"
              default 18
              help
                  The GPIO number the Relay is connected to.

      config ESP_SETUP_CODE
              string "HomeKit Setup Code"
              default "778-33-887"
              help
                  If you want to change the HomeKit Setup Code, you can do that here (Note:  you need to make a new QR-CODE To make it work)

      config ESP_SETUP_ID
              string "HomeKit Setup ID"
              default "2R9K"
              help
                   If you want to change the HomeKit Setup ID, you can do that here (Note: you need to make a new QR-CODE To make it work)

endmenu
```

## examples/motion_sensor/main/Kconfig.projbuild
```kconfig
menu "StudioPieters"

      config ESP_WIFI_SSID
              string "WiFi SSID"
              default "myssid"
              help
                  SSID (network name) for the example to connect to.

      config ESP_WIFI_PASSWORD
              string "WiFi Password"
              default "mypassword"
              help
                  WiFi password (WPA or WPA2) for the example to use.

      config ESP_LED_GPIO
              int "Set the GPIO for the LED"
              default 2
              help
                  The GPIO number the LED is connected to.

       config ESP_MOTION_SENSOR_GPIO
              int "Data GPIO number"
              default 4 if IDF_TARGET_ESP8266 || IDF_TARGET_ESP32C3
              default 17 if IDF_TARGET_ESP32 || IDF_TARGET_ESP32S2 || IDF_TARGET_ESP32S3
              help
                GPIO number connected to DATA pin

      config ESP_SETUP_CODE
              string "HomeKit Setup Code"
              default "338-77-883"
              help
                  If you want to change the HomeKit Setup Code, you can do that here (Note:  you need to make a new QR-CODE To make it work)

      config ESP_SETUP_ID
              string "HomeKit Setup ID"
              default "1QJ8"
              help
                   If you want to change the HomeKit Setup ID, you can do that here (Note: you need to make a new QR-CODE To make it work)

endmenu
```

## examples/neopixel_rgbic_led_strip/main/Kconfig.projbuild
```kconfig
menu "StudioPieters"

      config ESP_WIFI_SSID
              string "WiFi SSID"
              default "myssid"
              help
                  SSID (network name) for the example to connect to.

      config ESP_WIFI_PASSWORD
              string "WiFi Password"
              default "mypassword"
              help
                  WiFi password (WPA or WPA2) for the example to use.

      config ESP_LED_GPIO
              int "Set the GPIO for the LED"
              default 5
              help
                  The GPIO number the LED is connected to.

      config ESP_STRIP_LENGTH
              int "Set the number of LED's of your strip"
              default 3
              help
                  The number of LED's On the connected strip.

      config ESP_COLD_WHITE_GPIO
              int "Set the GPIO for the warm white LED"
              default 18
              help
                  Generally, GPIOs like GPIO18, GPIO19, GPIO21, GPIO22, GPIO23, and GPIO25-27 are commonly used with the ledc driver.

      config ESP_WARM_WHITE_GPIO
              int "Set the GPIO for the cold white LED"
              default 19
              help
                  Generally, GPIOs like GPIO18, GPIO19, GPIO21, GPIO22, GPIO23, and GPIO25-27 are commonly used with the ledc driver.

      config ESP_SETUP_CODE
              string "HomeKit Setup Code"
              default "227-66-772"
              help
                  If you want to change the HomeKit Setup Code, you can do that here (Note:  you need to make a new QR-CODE To make it work)

      config ESP_SETUP_ID
              string "HomeKit Setup ID"
              default "1QJ8"
              help
                   If you want to change the HomeKit Setup ID, you can do that here (Note: you need to make a new QR-CODE To make it work)

endmenu
```

## examples/outlet/main/Kconfig.projbuild
```kconfig
menu "StudioPieters"

      config ESP_WIFI_SSID
              string "WiFi SSID"
              default "myssid"
              help
                  SSID (network name) for the example to connect to.

      config ESP_WIFI_PASSWORD
              string "WiFi Password"
              default "mypassword"
              help
                  WiFi password (WPA or WPA2) for the example to use.

      config ESP_LED_GPIO
              int "Set the GPIO for the LED"
              default 2
              help
                  The GPIO number the LED is connected to.

      config ESP_BUTTON_1_GPIO
              int "Set the GPIO for the Toggle Button 1"
              default 34
              help
                  This the default GPIO of the toggle button of an ESP board.

      config ESP_BUTTON_2_GPIO
              int "Set the GPIO for the Toggle Button 2"
              default 35
              help
                  This the default GPIO of the toggle button of an ESP board.

      config ESP_BUTTON_3_GPIO
              int "Set the GPIO for the Toggle Button 3 s"
              default 36
              help
                  This the default GPIO of the toggle button of an ESP board.

      config ESP_RELAY_1_GPIO
              int "Set the GPIO for the Relay 1"
              default 25
              help
                  The GPIO number the Relay is connected to.

      config ESP_RELAY_2_GPIO
              int "Set the GPIO for the Relay 2"
              default 26
              help
                  The GPIO number the Relay is connected to.

      config ESP_RELAY_3_GPIO
              int "Set the GPIO for the Relay 3"
              default 27
              help
                  The GPIO number the Relay is connected to.

      config ESP_SETUP_CODE
              string "HomeKit Setup Code"
              default "778-33-887"
              help
                  If you want to change the HomeKit Setup Code, you can do that here (Note:  you need to make a new QR-CODE To make it work)

      config ESP_SETUP_ID
              string "HomeKit Setup ID"
              default "2R9K"
              help
                   If you want to change the HomeKit Setup ID, you can do that here (Note: you need to make a new QR-CODE To make it work)

endmenu
```
