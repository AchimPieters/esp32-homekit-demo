## components/wolfssl/Kconfig
```kconfig
menu "wolfSSL"
    config WOLFSSL_APPLE_HOMEKIT
        bool "Enable Apple HomeKit options"
        default n
        help
            Enables FP_MAX_BITS (8192 * 2), SRP, ChaCha, Poly1305, Base64 encoding needed for Apple Homekit.

    config ESP_ENABLE_WOLFSSH
        bool "Enable wolfSSH options"
        default n
        help
            Enables WOLFSSH_TERM, WOLFSSL_KEY_GEN, WOLFSSL_PTHREADS, WOLFSSH_TEST_SERVER, WOLFSSH_TEST_THREADING needed for wolfSSH.

    config TLS_STACK_WOLFSSL
        bool "Include wolfSSL in ESP-TLS"
        default y
        select FREERTOS_ENABLE_BACKWARD_COMPATIBILITY
        help
            Includes wolfSSL in ESP-TLS so that it can be compiled with wolfSSL as its SSL/TLS library.

    config WOLFSSL_HAVE_ALPN
        bool "Enable ALPN (Application Layer Protocol Negotiation) in wolfSSL"
        default y

endmenu # wolfSSL
```

## examples/Garage_Door_Opener/main/Kconfig.projbuild
```kconfig
menu "StudioPieters"

      config ESP_WIFI_SSID
              string "WiFi SSID"
              default "myssid"
              help
                  SSID (network name) for the example to connect to.

      config ESP_WIFI_PASSWORD
              string "WiFi Password"
              default "mypassword"
              help
                  WiFi password (WPA or WPA2) for the example to use.

      config ESP_LED_GPIO
              int "Set the GPIO for the LED"
              default 2
              help
                  The GPIO number the LED is connected to.

      config ESP_RELAY_OPEN_GPIO
              int "Set the GPIO for the relay to open the garage port"
              default 17
              help
                  The GPIO number the relay is connected to.

      config ESP_RELAY_CLOSE_GPIO
              int "Set the GPIO for the relay to close the garage port"
              default 18
              help
                The GPIO number the relay is connected to.

      config ESP_REED_OPEN_GPIO
              int "Set the GPIO for the A3144 sensor to see if the garage port is open"
              default 22
              help
                The GPIO number the A3144 sensor is connected to.

      config ESP_REED_CLOSE_GPIO
              int "Set the GPIO for the A3144 sensor to see if the garage port is closed"
              default 23
              help
                The GPIO number the A3144 sensor is connected to.

      config ESP_DELAY
              int "Wait for 5 seconds"
              default 5000
              help
                The GPIO number the A3144 sensor is connected to.

      config ESP_SETUP_CODE
              string "HomeKit Setup Code"
              default "338-77-883"
              help
                  If you want to change the HomeKit Setup Code, you can do that here (Note:  you need to make a new QR-CODE To make it work)

      config ESP_SETUP_ID
              string "HomeKit Setup ID"
              default "1QJ8"
              help
                   If you want to change the HomeKit Setup ID, you can do that here (Note: you need to make a new QR-CODE To make it work)

endmenu
```

## examples/heating_fan/main/Kconfig.projbuild
```kconfig
menu "StudioPieters"

      config ESP_WIFI_SSID
              string "WiFi SSID"
              default "myssid"
              help
                  SSID (network name) for the example to connect to.

      config ESP_WIFI_PASSWORD
              string "WiFi Password"
              default "mypassword"
              help
                  WiFi password (WPA or WPA2) for the example to use.

      config ESP_LED_GPIO
              int "Set the GPIO for the LED"
              default 2
              help
                  The GPIO number the LED is connected to.

      config ESP_BUTTON_GPIO
              int "Set the GPIO for the Button"
              default 4 if IDF_TARGET_ESP8266 || IDF_TARGET_ESP32C3 || IDF_TARGET_ESP32C2 || IDF_TARGET_ESP32C6
              default 17 if IDF_TARGET_ESP32 || IDF_TARGET_ESP32S2 || IDF_TARGET_ESP32S3
              help
                  This the default GPIO of the Program button of an ESP board.


      config SHT3X_I2C_ADDRESS
              hex "I2C address of the SHT3X sensor"
              default 0x44
              range 0x44 0x45
              help
                  Specify the I2C address of the SHT3X sensor.
                  Common addresses are 0x44 or 0x45, depending on the sensor configuration.

      config I2C_MASTER_SCL
              int "GPIO number for SCL"
              default 5 if IDF_TARGET_ESP8266
              default 6 if IDF_TARGET_ESP32C3
              default 21 if IDF_TARGET_ESP32 || IDF_TARGET_ESP32S2 || IDF_TARGET_ESP32S3
              help
                  GPIO number for I2C master clock line (SCL).

      config I2C_MASTER_SDA
              int "GPIO number for SDA"
              default 4 if IDF_TARGET_ESP8266
              default 5 if IDF_TARGET_ESP32C3
              default 22 if IDF_TARGET_ESP32 || IDF_TARGET_ESP32S2 || IDF_TARGET_ESP32S3
              help
                  GPIO number for I2C master data line (SDA).

      config ESP_SETUP_CODE
              string "HomeKit Setup Code"
              default "338-77-883"
              help
                  If you want to change the HomeKit Setup Code, you can do that here (Note:  you need to make a new QR-CODE To make it work)

      config ESP_SETUP_ID
              string "HomeKit Setup ID"
              default "1QJ8"
              help
                   If you want to change the HomeKit Setup ID, you can do that here (Note: you need to make a new QR-CODE To make it work)

endmenu
```

## examples/ip_camera/sdkconfig.defaults
```kconfig
#
# StudioPieters
#

# General Optimization
CONFIG_COMPILER_OPTIMIZATION_SIZE=y


# Binary Size Reduction
CONFIG_LOG_DEFAULT_LEVEL_ERROR=y
CONFIG_ESP_CONSOLE_UART_DEFAULT=n

# RAM Usage Minimization
# CONFIG_FREERTOS_IDLE_TASK_STACKSIZE=512
# CONFIG_FREERTOS_ISR_STACKSIZE=1536
CONFIG_HEAP_POISONING_DISABLED=y
CONFIG_HEAP_TRACING_OFF=y

#
# HomeKit
#
CONFIG_HOMEKIT_MAX_CLIENTS=16
CONFIG_HOMEKIT_SMALL=y
CONFIG_HOMEKIT_DEBUG=y
# end of HomeKit

#
# wolfSSL
#
CONFIG_WOLFSSL_APPLE_HOMEKIT=y
CONFIG_ESP_MAIN_TASK_STACK_SIZE=10500
```

## examples/ip_camera/sdkconfig.defaults.esp32
```kconfig
CONFIG_ESP_DEFAULT_CPU_FREQ_MHZ_240=y

CONFIG_ESPTOOLPY_FLASHMODE_DIO=y
CONFIG_ESPTOOLPY_FLASHFREQ_40M=y
CONFIG_ESPTOOLPY_FLASHSIZE_4MB=y
CONFIG_ESPTOOLPY_BEFORE_RESET=y
CONFIG_ESPTOOLPY_AFTER_RESET=y
CONFIG_ESPTOOLPY_MONITOR_BAUD=115200

CONFIG_PARTITION_TABLE_CUSTOM=y
CONFIG_PARTITION_TABLE_CUSTOM_FILENAME="partitions/partitions_esp32.csv"
CONFIG_PARTITION_TABLE_FILENAME="partitions/partitions_esp32.csv"
CONFIG_PARTITION_TABLE_OFFSET=0x8000
CONFIG_PARTITION_TABLE_MD5=y
```

## examples/lcm/main/Kconfig.projbuild
```kconfig
menu "StudioPieters"

      config ESP_LED_GPIO
              int "Set the GPIO for the LED"
              default 2
              help
                  The GPIO number the LED is connected to.

      config ESP_SETUP_CODE
              string "HomeKit Setup Code"
              default "338-77-883"
              help
                  If you want to change the HomeKit Setup Code, you can do that here (Note:  you need to make a new QR-CODE To make it work)

      config ESP_SETUP_ID
              string "HomeKit Setup ID"
              default "1QJ8"
              help
                   If you want to change the HomeKit Setup ID, you can do that here (Note: you need to make a new QR-CODE To make it work)

endmenu
```

## examples/lcm/sdkconfig.defaults
```kconfig
#
# StudioPieters
#

# General Optimization
CONFIG_COMPILER_OPTIMIZATION_SIZE=y


# Binary Size Reduction
CONFIG_LOG_DEFAULT_LEVEL_ERROR=y
CONFIG_ESP_CONSOLE_UART_DEFAULT=n

# RAM Usage Minimization
# CONFIG_FREERTOS_IDLE_TASK_STACKSIZE=512
# CONFIG_FREERTOS_ISR_STACKSIZE=1536
CONFIG_HEAP_POISONING_DISABLED=y
CONFIG_HEAP_TRACING_OFF=y

#
# HomeKit
#
CONFIG_HOMEKIT_MAX_CLIENTS=16
CONFIG_HOMEKIT_SMALL=y
CONFIG_HOMEKIT_DEBUG=y
# end of HomeKit

#
# wolfSSL settings
#
CONFIG_WOLFSSL_APPLE_HOMEKIT=y

#
# Life Cycle Manger settings
#
CONFIG_BOOTLOADER_RESERVE_RTC_SIZE=0x10
CONFIG_BOOTLOADER_CUSTOM_RESERVE_RTC=y
CONFIG_BOOTLOADER_CUSTOM_RESERVE_RTC_SIZE=0x04
```

## examples/led/main/Kconfig.projbuild
```kconfig
menu "StudioPieters"

config LED_GPIO
  int "Set the GPIO for the LED"
  default 4
  help
  The GPIO number the LED is connected to.

endmenu
```

## examples/led/sdkconfig.defaults.esp32c6
```kconfig
#
# Watchdog Timer config
#
CONFIG_TASK_WDT_TIMEOUT_S=10
CONFIG_ESP_TASK_WDT_TIMEOUT_S=10

CONFIG_PARTITION_TABLE_CUSTOM=y
CONFIG_PARTITION_TABLE_CUSTOM_FILENAME="partitions/partitions_esp32c6.csv"
CONFIG_PARTITION_TABLE_FILENAME="partitions/partitions_esp32c6.csv"


 #
 # Serial flasher config
 #


 CONFIG_ESPTOOLPY_FLASHSIZE_4MB=y
```

## examples/led/sdkconfig.defaults.esp32h2
```kconfig
#
# Watchdog Timer config
#
CONFIG_TASK_WDT_TIMEOUT_S=60
CONFIG_ESP_TASK_WDT_TIMEOUT_S=60

CONFIG_PARTITION_TABLE_CUSTOM=y
CONFIG_PARTITION_TABLE_CUSTOM_FILENAME="partitions/partitions_esp32h2.csv"
CONFIG_PARTITION_TABLE_FILENAME="partitions/partitions_esp32h2.csv"
```

## examples/led/sdkconfig.defaults.esp32s2
```kconfig
# sdkconfig.defaults.esp32s2

#
# Watchdog Timer config
#
CONFIG_TASK_WDT_TIMEOUT_S=60
CONFIG_ESP_TASK_WDT_TIMEOUT_S=60


#
# Partition Table
#
CONFIG_PARTITION_TABLE_CUSTOM=y
CONFIG_PARTITION_TABLE_CUSTOM_FILENAME="partitions/partitions_esp32s2.csv"
CONFIG_PARTITION_TABLE_FILENAME="partitions/partitions_esp32s2.csv"
```

## examples/led/sdkconfig.defaults.esp32s3
```kconfig
CONFIG_PARTITION_TABLE_CUSTOM=y
CONFIG_PARTITION_TABLE_CUSTOM_FILENAME="partitions/partitions_esp32s3.csv"
CONFIG_PARTITION_TABLE_FILENAME="partitions/partitions_esp32s3.csv"
```

## examples/led_bt/main/Kconfig.projbuild
```kconfig
menu "StudioPieters"

    config EXAMPLE_SSP_ENABLED
            bool "Secure Simple Pairing"
            depends on BT_CLASSIC_ENABLED
            default y
            help
                This enables the Secure Simple Pairing. If disable this option,
                Bluedroid will only support Legacy Pairing


      config ESP_LED_GPIO
              int "Set the GPIO for the LED"
              default 2
              help
                  The GPIO number the LED is connected to.

      config ESP_SETUP_CODE
              string "HomeKit Setup Code"
              default "338-77-883"
              help
                  If you want to change the HomeKit Setup Code, you can do that here (Note:  you need to make a new QR-CODE To make it work)

      config ESP_SETUP_ID
              string "HomeKit Setup ID"
              default "1QJ8"
              help
                   If you want to change the HomeKit Setup ID, you can do that here (Note: you need to make a new QR-CODE To make it work)

endmenu
```

## examples/light/main/Kconfig.projbuild
```kconfig
menu "StudioPieters"

      config ESP_WIFI_SSID
              string "WiFi SSID"
              default "myssid"
              help
                  SSID (network name) for the example to connect to.

      config ESP_WIFI_PASSWORD
              string "WiFi Password"
              default "mypassword"
              help
                  WiFi password (WPA or WPA2) for the example to use.

      config ESP_LED_GPIO
              int "Set the GPIO for the LED"
              default 2
              help
                  The GPIO number the LED is connected to.

      config ESP_STRIP_LENGTH
              int "Set the number of LED's of your strip"
              default 3
              help
                  The number of LED's On the connected strip.

      config ESP_SETUP_CODE
              string "HomeKit Setup Code"
              default "338-77-883"
              help
                  If you want to change the HomeKit Setup Code, you can do that here (Note:  you need to make a new QR-CODE To make it work)

      config ESP_SETUP_ID
              string "HomeKit Setup ID"
              default "1QJ8"
              help
                   If you want to change the HomeKit Setup ID, you can do that here (Note: you need to make a new QR-CODE To make it work)

endmenu
```

## examples/light_RGBW_strip/sdkconfig.defaults.esp32p4
```kconfig
CONFIG_PARTITION_TABLE_CUSTOM=y
CONFIG_PARTITION_TABLE_CUSTOM_FILENAME="partitions/partitions_esp32p4.csv"
CONFIG_PARTITION_TABLE_FILENAME="partitions/partitions_esp32p4.csv"
```

## examples/light_sensor/main/Kconfig.projbuild
```kconfig
menu "StudioPieters"

      config ESP_WIFI_SSID
              string "WiFi SSID"
              default "myssid"
              help
                  SSID (network name) for the example to connect to.

      config ESP_WIFI_PASSWORD
              string "WiFi Password"
              default "mypassword"
              help
                  WiFi password (WPA or WPA2) for the example to use.

      config ESP_LED_GPIO
              int "Set the GPIO for the LED"
              default 2
              help
                  The GPIO number the LED is connected to.

      choice ESP_I2C_ADDRESS
                prompt "Select I2C address"
                default ESP_I2C_ADDRESS_LO
                help
                    Select I2C address

      config ESP_I2C_ADDRESS_LO
                bool "BH1750_ADDR_LO"
                help
                    Choose this when ADDR pin is floating or low.
      config ESP_I2C_ADDRESS_HI
                bool "BH1750_ADDR_HI"
                help
                    Choose this when ADDR pin is high.
      endchoice

      config ESP_I2C_MASTER_SCL
                int "SCL GPIO Number"
                default 5 if IDF_TARGET_ESP8266
                default 6 if IDF_TARGET_ESP32C3
                default 19 if IDF_TARGET_ESP32 || IDF_TARGET_ESP32S2 || IDF_TARGET_ESP32S3
                help
                    GPIO number for I2C Master clock line.

      config ESP_I2C_MASTER_SDA
                int "SDA GPIO Number"
                default 4 if IDF_TARGET_ESP8266
                default 5 if IDF_TARGET_ESP32C3
                default 18 if IDF_TARGET_ESP32 || IDF_TARGET_ESP32S2 || IDF_TARGET_ESP32S3
                help
                    GPIO number for I2C Master data line.

      config ESP_SETUP_CODE
              string "HomeKit Setup Code"
              default "338-77-883"
              help
                  If you want to change the HomeKit Setup Code, you can do that here (Note:  you need to make a new QR-CODE To make it work)

      config ESP_SETUP_ID
              string "HomeKit Setup ID"
              default "1QJ8"
              help
                   If you want to change the HomeKit Setup ID, you can do that here (Note: you need to make a new QR-CODE To make it work)

endmenu
```
